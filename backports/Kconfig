## backports/Kconfig
```kconfig
config BACKPORT_INTEGRATE
	bool
	def_bool y

config BACKPORT_DIR
	string
	default "backports/"

config BACKPORT_VERSION
	string
	default "d13ca803"

config BACKPORT_KERNEL_VERSION
	string
	default "v4.2-0-g64291f7db5bd"

config BACKPORT_KERNEL_NAME
	string
	default "Linux"

menuconfig BACKPORT_LINUX
	bool "Backport Linux v4.2-0-g64291f7db5bd (backports d13ca803)"
	default n
	---help---
	  Enabling this will let give you the opportunity to use features and
	  drivers backported from Linux v4.2-0-g64291f7db5bd
	  on the kernel your are using. This is experimental and you should
	  say no unless you'd like to help test things or want to help debug
	  this should we run into any issues.

if BACKPORT_LINUX

config BACKPORT_KERNEL_3_19
    def_bool y
config BACKPORT_KERNEL_4_0
    def_bool y
config BACKPORT_KERNEL_4_1
    def_bool y
config BACKPORT_KERNEL_4_2
    def_bool y

# this has the configuration for the backport code
source "$BACKPORT_DIR/compat/Kconfig"

# these are copied from the kernel
source "$BACKPORT_DIR/net/bluetooth/Kconfig"

source "$BACKPORT_DIR/net/6lowpan/Kconfig"
source "$BACKPORT_DIR/net/ieee802154/Kconfig"
source "$BACKPORT_DIR/net/mac802154/Kconfig"

endif # BACKPORT_LINUX
```
